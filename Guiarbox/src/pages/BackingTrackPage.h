#pragma once
#include "Page.h"
#include "../config/Colors.h"
#include "../menuItems/MenuItem.h"
#include "../menuItems/OptionsSelector.h"
#include "../menuItems/ToggleButton.h"
#include "../menuItems/SimpleButton.h"
#include "../config/SystemBitmaps.h"
#include "../config/Display.h"
#include "../config/AudioChain.h"
#include <SD.h>
#include <vector>

extern GFXBuffer_t display;
extern Bounce bounce;
extern void drawArrows();
extern int readEncoder();


const unsigned char BACKINGTRACK_HOME_BITMAP [] = {
	0x00, 0x00, 0x00, 0x00, 0x00, 0x00, 0x00, 0x00, 0x00, 0x00, 0x00, 0x00, 0x00, 0x00, 0x00, 0x00, 
	0x00, 0x00, 0x00, 0x00, 0x00, 0x00, 0x00, 0x00, 0x00, 0x00, 0x00, 0x00, 0x00, 0x00, 0x00, 0x00, 
	0x00, 0x00, 0x00, 0x00, 0x00, 0x00, 0x00, 0x00, 0x00, 0x00, 0x00, 0x00, 0x00, 0x00, 0x00, 0x00, 
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	0x00, 0x00, 0x00, 0x00, 0x00, 0x00, 0x00, 0x00, 0x00, 0x00, 0x00, 0x00, 0x00, 0x00, 0x00, 0x00
};

class BackingTrackPage : public Page {
private:
    MenuItem* menuItems[5] = {};
    int cursor = 0;

    std::vector<String> files;
    std::vector<String> displayNames;
    std::vector<String> shortNames;
    const char** fileOptions = nullptr;
    int fileCount = 0;
    int trackIndex = 0;
    int lastTrackIndex = 0;
    int volume = 10;

    bool isPlaying = false;
    bool filesLoaded = false;
    unsigned long playbackStartMs = 0;
    unsigned long lastBarUpdateMillis = 0;
    uint32_t cachedLengthMs = 0;
    uint32_t displayPositionMs = 0;

    int scrollOffsetPx = 0;
    int scrollPeriod = 0;
    bool scrollPausing = false;
    unsigned long scrollPauseStart = 0;
    unsigned long scrollLastStepMillis = 0;

    int timeCharCount(uint32_t ms) {
        uint32_t min = (ms / 1000) / 60;
        int minDigits = 1;
        if (min >= 100) {
            minDigits = 3;
        } else if (min >= 10) {
            minDigits = 2;
        }
        return minDigits + 3;
    }

    void printTime(int x, int y, uint32_t ms) {
        uint32_t sec = ms / 1000;
        uint32_t min = sec / 60;
        uint32_t s = sec % 60;
        display.setTextSize(1);
        display.setTextColor(WHITE, BLACK);
        display.setCursor(x, y);
        display.print(min);
        display.print(':');
        if (s < 10) {
            display.print('0');
        }
        display.print(s);
    }

    void recomputeScrollPeriod() {
        scrollPeriod = 0;
        if (fileCount == 0) {
            return;
        }
        int textWidth = displayNames[trackIndex].length() * 12;
        if (textWidth > 160) {
            scrollPeriod = textWidth + 48;
        }
        if (scrollPeriod > 0 && scrollOffsetPx >= scrollPeriod) {
            scrollOffsetPx = 0;
        }
    }

    void resetScroll() {
        scrollOffsetPx = 0;
        scrollPausing = false;
        scrollLastStepMillis = millis();
        recomputeScrollPeriod();
    }

    bool advanceScroll() {
        if (scrollPeriod == 0 && fileCount > 0) {
            recomputeScrollPeriod();
        }
        if (scrollPeriod == 0) {
            return false;
        }
        unsigned long now = millis();
        if (scrollPausing) {
            if (now - scrollPauseStart >= 1500) {
                scrollPausing = false;
            }
            return false;
        }
        if (now - scrollLastStepMillis < 50) {
            return false;
        }
        scrollLastStepMillis = now;
        if (++scrollOffsetPx >= scrollPeriod) {
            scrollOffsetPx = 0;
            scrollPausing = true;
            scrollPauseStart = now;
        }
        return true;
    }

    void playTrack() {
        if (fileCount == 0) {
            isPlaying = false;
            return;
        }
        backingTrackPlayWav.stop();
        displayPositionMs = 0;
        cachedLengthMs = 0;
        backingTrackPlayWav.play(files[trackIndex].c_str());
        playbackStartMs = millis();
        isPlaying = true;
        lastTrackIndex = trackIndex;
    }

    void stopTrack() {
        if (backingTrackPlayWav.isPlaying()) {
            uint32_t length = backingTrackPlayWav.lengthMillis();
            if (length > 0) {
                cachedLengthMs = length;
            }
            displayPositionMs = (backingTrackPlayWav.positionMillis() / 1000) * 1000;
        }
        backingTrackPlayWav.stop();
        isPlaying = false;
        playbackStartMs = 0;
    }

    bool playbackJustStarted() const {
        return playbackStartMs != 0 && (millis() - playbackStartMs) < 400;
    }

    void syncPlaybackState(bool redrawIfActive) {
        if (!isPlaying) {
            return;
        }
        if (backingTrackPlayWav.isPlaying()) {
            return;
        }
        if (playbackJustStarted()) {
            return;
        }

        isPlaying = false;
        playbackStartMs = 0;
        if (cachedLengthMs > 0) {
            displayPositionMs = cachedLengthMs;
        }
        if (redrawIfActive && isActive()) {
            draw();
        }
    }

    void onTrackChanged() {
        if (trackIndex == lastTrackIndex) {
            return;
        }
        lastTrackIndex = trackIndex;
        resetScroll();
        if (isPlaying) {
            playTrack();
        }
    }

    void draw() {
        playSDMixer.gain(0, float(volume) / 10.0f);
        playSDMixer.gain(1, float(volume) / 10.0f);

        display.fillScreen(BLACK);

        // Scrolling full file name between top row and progress bar
        display.fillRect(0, 8, 160, 34, BLACK);
        if (fileCount > 0) {
            display.setTextSize(2);
            display.setTextWrap(false);
            display.setTextColor(WHITE, BLACK);
            const char* name = displayNames[trackIndex].c_str();
            int x = -scrollOffsetPx;
            display.setCursor(x, 18);
            display.print(name);
            if (scrollPeriod > 0) {
                display.setCursor(x + scrollPeriod, 18);
                display.print(name);
            }
        }

        // Progress bar track
        display.fillRect(0, 43, 160, 17, BLACK);
        display.drawFastHLine(10, 47, 140, GRAY);

        // Progress bar fill and playhead
        uint32_t length = cachedLengthMs;
        uint32_t position = displayPositionMs;
        int x = length > 0 ? map(position, 0, length, 10, 150) : 10;
        int clampedX = constrain(x, 10, 150);
        if (clampedX > 10) {
            display.fillRect(10, 46, clampedX - 10, 3, WHITE);
        }
        display.fillCircle(clampedX, 47, 3, WHITE);

        // Elapsed and total time below bar ends
        printTime(10, 52, displayPositionMs);
        printTime(150 - timeCharCount(cachedLengthMs) * 6, 52, cachedLengthMs);

        // Back button, file selector, prev / play / next
        for (MenuItem* menuItem : menuItems) {
            if (menuItem) {
                menuItem->draw();
            }
        }
        flushDisplay();
    }

    void previousTrack() {
        if (fileCount == 0) {
            return;
        }
        if (isPlaying && backingTrackPlayWav.positionMillis() > 3000) {
            playTrack();
            if (isActive()) {
                draw();
            }
            return;
        }
        trackIndex = (trackIndex - 1 + fileCount) % fileCount;
        onTrackChanged();
    }

    void nextTrack() {
        if (fileCount == 0) {
            return;
        }
        trackIndex = (trackIndex + 1) % fileCount;
        onTrackChanged();
    }

public:
    bool isTrackPlaying() const {
        return isPlaying;
    }

    void refresh() override {
        if (!isActive()) {
            home();
            return;
        }
        draw();
    }

    BackingTrackPage() {
        menuItems[0] = new SimpleButton(0, 0, 0, "<", [this]() { home(); }, 1, Align::Left);           // back
        menuItems[2] = new SimpleButton(48, 60, 16, PREVIOUS_TRACK, 16, 16, [this]() { previousTrack(); }, Align::Left);
        menuItems[3] = new ToggleButton(72, 60, PLAYING, PAUSED, 16, 16, &isPlaying);                    // play / pause
        menuItems[4] = new SimpleButton(96, 60, 16, NEXT_TRACK, 16, 16, [this]() { nextTrack(); }, Align::Left);

        menuItems[0]->setFocused(true);
    }

    void initFiles() {
        if (filesLoaded) {
            return;
        }

        files.clear();
        displayNames.clear();
        shortNames.clear();
        if (!SD.exists("backingtracks")) {
            SD.mkdir("backingtracks");
        }
        File dir = SD.open("backingtracks");
        if (dir) {
            while (true) {
                File entry = dir.openNextFile();
                if (!entry) {
                    break;
                }
                if (!entry.isDirectory()) {
                    String path = entry.name();
                    if (path.charAt(0) != '/') {
                        path = "/backingtracks/" + path;
                    }
                    files.push_back(path);
                    String name = path.substring(path.lastIndexOf('/') + 1);
                    displayNames.push_back(name);
                    if (name.length() > 10) {
                        name = name.substring(0, 10) + "...";
                    }
                    shortNames.push_back(name);
                    Serial.println(displayNames.back());
                }
                entry.close();
            }
            dir.close();
        }

        delete[] fileOptions;
        fileOptions = nullptr;

        fileCount = files.size();
        if (fileCount > 0) {
            fileOptions = new const char*[fileCount];
            for (int i = 0; i < fileCount; i++) {
                fileOptions[i] = shortNames[i].c_str();
            }
        }

        trackIndex = constrain(trackIndex, 0, max(fileCount - 1, 0));
        lastTrackIndex = trackIndex;

        if (menuItems[1]) {
            delete menuItems[1];
            menuItems[1] = nullptr;
        }
        menuItems[1] = new OptionsSelector(18, 0, 142, "File:", fileOptions, fileCount, &trackIndex, 1, Align::Left); // file selector

        playSDMixer.gain(0, 1);
        playSDMixer.gain(1, 1);
        filesLoaded = true;
        resetScroll();
    }

    void home() override {
        setActive(false);
        display.fillScreen(BLACK);
        display.drawBitmap(0, 0, BACKINGTRACK_HOME_BITMAP, 160, 80, WHITE); // page icon
        drawArrows();                                                          // left / right page nav
        flushDisplay();
    }

    void setup() override {
        isPlaying = backingTrackPlayWav.isPlaying();
        if (isPlaying) {
            uint32_t length = backingTrackPlayWav.lengthMillis();
            if (length > 0) {
                cachedLengthMs = (length / 1000) * 1000;
            }
            if (backingTrackPlayWav.isPlaying()) {
                displayPositionMs = (backingTrackPlayWav.positionMillis() / 1000) * 1000;
            }
        }
        recomputeScrollPeriod();
        cursor = 0;
        for (int i = 0; i < 5; i++) {
            if (menuItems[i]) {
                menuItems[i]->setFocused(i == 0);
            }
        }
        draw();
    }

    void loop() override {
        if (bounce.fell()) {
            if (cursor == 3) {
                if (isPlaying) {
                    stopTrack();
                } else {
                    playTrack();
                }
            } else {
                menuItems[cursor]->onButtonPress();
            }
            onTrackChanged();
            if (isActive()) {
                draw();
            }
        }

        int encoder = readEncoder();
        if (encoder != 0) {
            MenuItem* currentItem = menuItems[cursor];
            const int next = cursor + encoder;
            if (!currentItem->onEncoderTurn(encoder) && next >= 0 && next < 5) {
                currentItem->setFocused(false);
                cursor = next;
                menuItems[cursor]->setFocused(true);
            }
            onTrackChanged();
            if (isActive()) {
                draw();
            }
        }
    }

    void update() override {
        syncPlaybackState(true);

        if (!isActive()) {
            return;
        }

        bool needDraw = advanceScroll();

        if (isPlaying) {
            unsigned long now = millis();
            if (now - lastBarUpdateMillis >= 1000) {
                lastBarUpdateMillis = now;
                uint32_t length = backingTrackPlayWav.lengthMillis();
                if (length > 0) {
                    cachedLengthMs = (length / 1000) * 1000;
                }
                if (backingTrackPlayWav.isPlaying()) {
                    displayPositionMs = (backingTrackPlayWav.positionMillis() / 1000) * 1000;
                }
                needDraw = true;
            }
        }

        if (needDraw) {
            draw();
        }
    }
};