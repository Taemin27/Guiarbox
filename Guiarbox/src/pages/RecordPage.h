#pragma once
#include "Page.h"
#include "../config/Colors.h"
#include "../menuItems/MenuItem.h"
#include "../menuItems/OptionsSelector.h"
#include "../menuItems/ToggleButton.h"
#include "../menuItems/SimpleButton.h"
#include "../menuItems/IntEditor.h"
#include "../config/SystemBitmaps.h"
#include "../config/Display.h"
#include "../config/AudioChain.h"
#include "../utils/WavHeader.h"
#include "../utils/SdAudioActivity.h"
#include <SD.h>
#include <functional>

extern GFXBuffer_t display;
extern Bounce bounce;
extern void drawArrows();
extern int readEncoder();

const unsigned char RECORD_HOME_BITMAP [] = {
	0x00, 0x00, 0x00, 0x00, 0x00, 0x00, 0x00, 0x00, 0x00, 0x00, 0x00, 0x00, 0x00, 0x00, 0x00, 0x00,
	0x00, 0x00, 0x00, 0x00, 0x00, 0x00, 0x00, 0x00, 0x00, 0x00, 0x00, 0x00, 0x00, 0x00, 0x00, 0x00,
	0x00, 0x00, 0x00, 0x00, 0x00, 0x00, 0x00, 0x00, 0x00, 0x00, 0x00, 0x00, 0x00, 0x00, 0x00, 0x00,
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	0x00, 0x00, 0x00, 0x00, 0x00, 0x00, 0x00, 0x00, 0x00, 0x00, 0x00, 0x00, 0x00, 0x00, 0x00, 0x00
};

class RecordButton : public MenuItem {
public:
    enum class Visual : uint8_t {
        Circle,
        Square,
        Triangle,
        Pause
    };

    using Callback = std::function<void()>;
    using VisualProvider = std::function<Visual()>;

    RecordButton(int16_t cx, int16_t cy, VisualProvider visualProvider, Callback onPress = nullptr)
        : MenuItem(cx - 8, cy - 8),
          centerX(cx),
          centerY(cy),
          visualProvider(std::move(visualProvider)),
          onPress(std::move(onPress)) {}

    void draw() override {
        Visual visual = visualProvider ? visualProvider() : Visual::Circle;
        static constexpr int16_t iconW = 16;
        static constexpr int16_t iconH = 16;
        const int16_t iconX = centerX - iconW / 2;
        const int16_t iconY = centerY - iconH / 2;

        display.fillRect(iconX, iconY, iconW, iconH, BLACK);

        const uint16_t iconColor = isFocused() ? BLUE : WHITE;

        switch (visual) {
            case Visual::Circle:
                display.fillCircle(centerX, centerY, 7, RED);
                if (isFocused()) {
                    display.drawCircle(centerX, centerY, 8, BLUE);
                }
                break;
            case Visual::Square:
                display.fillRoundRect(iconX, iconY, iconW, iconH, 3, RED);
                if (isFocused()) {
                    display.drawRect(iconX, iconY, iconW, iconH, BLUE);
                }
                break;
            case Visual::Triangle:
                display.drawBitmap(iconX, iconY, PAUSED, iconW, iconH, iconColor);
                break;
            case Visual::Pause:
                display.drawBitmap(iconX, iconY, PLAYING, iconW, iconH, iconColor);
                break;
        }
    }

    void onButtonPress() override {
        if (isFocused() && onPress) {
            onPress();
        }
    }

private:
    int16_t centerX;
    int16_t centerY;
    VisualProvider visualProvider;
    Callback onPress;
};

class RecordPage : public Page {
private:
    static constexpr int MENU_ITEM_COUNT = 5;
    static constexpr int RECORD_BANK_SIZE = 99;

    MenuItem* menuItems[MENU_ITEM_COUNT] = {};
    int cursor = 0;
    int sourceIndex = 0;
    int lastBank = 0;
    int currentBank = 0;
    int state = 0; // 0: stopped, 1: recording, 2: playing
    bool bankUsed[RECORD_BANK_SIZE] = {};
    File recordFile;
    bool initialized = false;
    uint32_t recordedBytes = 0;
    int recordingBank = -1;
    int recordingSourceIndex = 0;
    RecordButton::Visual lastVisual = RecordButton::Visual::Circle;
    unsigned long playbackStartMs = 0;

    const char* sourceOptions[3] = {"Everything", "Guitar", "Guitar Raw"};

    static constexpr uint32_t kRecordBlockBytes = AUDIO_BLOCK_SAMPLES * sizeof(int16_t);
    static constexpr uint32_t kSectorBytes = kRecordBlockBytes * 2;

    String bankFilename(int bank) const {
        return "recordings/RECORD" + String(bank) + ".WAV";
    }

    static void recordingPath(int bank, char* path, size_t pathSize) {
        snprintf(path, pathSize, "recordings/RECORD%d.WAV", bank);
    }

    AudioRecordQueue* queueForSource(int source) {
        switch (source) {
            case 1:
                return &recordGuitarQueue;
            case 2:
                return &recordGuitarRawQueue;
            default:
                return &recordEverythingQueue;
        }
    }

    void continueRecording() {
        if (state != 1 || !recordFile || recordingBank < 0) {
            return;
        }

        AudioRecordQueue* queue = queueForSource(recordingSourceIndex);
        if (queue->available() < 2) {
            return;
        }

        alignas(4) uint8_t buffer[kSectorBytes];
        memcpy(buffer, queue->readBuffer(), kRecordBlockBytes);
        queue->freeBuffer();
        memcpy(buffer + kRecordBlockBytes, queue->readBuffer(), kRecordBlockBytes);
        queue->freeBuffer();
        recordFile.write(buffer, kSectorBytes);
        recordedBytes += kSectorBytes;
    }

    void startRecording() {
        const int bank = constrain(currentBank, 0, RECORD_BANK_SIZE - 1);
        const String path = bankFilename(bank);

        SD.remove(path.c_str());
        recordFile = SD.open(path.c_str(), FILE_WRITE);
        if (!recordFile) {
            return;
        }

        recordingBank = bank;
        recordingSourceIndex = sourceIndex;
        WavHeader::write(recordFile, 0);
        recordedBytes = 0;
        queueForSource(recordingSourceIndex)->begin();
        sdRecordingActive = true;
        state = 1;
    }

    void stopRecording() {
        if (state != 1 || recordingBank < 0) {
            return;
        }

        AudioRecordQueue* queue = queueForSource(recordingSourceIndex);
        queue->end();
        while (queue->available() >= 2) {
            alignas(4) uint8_t buffer[kSectorBytes];
            memcpy(buffer, queue->readBuffer(), kRecordBlockBytes);
            queue->freeBuffer();
            memcpy(buffer + kRecordBlockBytes, queue->readBuffer(), kRecordBlockBytes);
            queue->freeBuffer();
            recordFile.write(buffer, kSectorBytes);
            recordedBytes += kSectorBytes;
        }
        while (queue->available() > 0) {
            recordFile.write((const uint8_t*)queue->readBuffer(), kRecordBlockBytes);
            recordedBytes += kRecordBlockBytes;
            queue->freeBuffer();
        }

        if (recordFile) {
            WavHeader::patch(recordFile, recordedBytes);
            recordFile.close();
        }

        bankUsed[recordingBank] = recordedBytes > 0;
        recordedBytes = 0;
        recordingBank = -1;
        sdRecordingActive = false;
        state = 0;
    }

    void startPlayback() {
        const int bank = constrain(currentBank, 0, RECORD_BANK_SIZE - 1);
        recorderPlayWav.stop();
        recorderPlayWav.play(bankFilename(bank).c_str());
        playbackStartMs = millis();
        state = 2;
    }

    void stopPlayback() {
        recorderPlayWav.stop();
        state = 0;
        playbackStartMs = 0;
    }

    void stopIfActive() {
        if (state == 1) {
            stopRecording();
        } else if (state == 2) {
            stopPlayback();
        }
    }

    void leavePage() {
        setActive(false);
        home();
    }

    RecordButton::Visual currentVisual() {
        if (state == 1) {
            return RecordButton::Visual::Square;
        }
        if (state == 2) {
            return RecordButton::Visual::Pause;
        }
        const int bank = constrain(currentBank, 0, RECORD_BANK_SIZE - 1);
        if (bankUsed[bank]) {
            return RecordButton::Visual::Triangle;
        }
        return RecordButton::Visual::Circle;
    }

    void onRecordPress() {
        const int bank = constrain(currentBank, 0, RECORD_BANK_SIZE - 1);
        if (state == 1) {
            stopRecording();
        } else if (state == 2) {
            stopPlayback();
        } else if (bankUsed[bank]) {
            startPlayback();
        } else {
            startRecording();
        }
    }

    void onClearPress() {
        if (state != 0) {
            return;
        }
        const int bank = constrain(currentBank, 0, RECORD_BANK_SIZE - 1);
        bankUsed[bank] = false;
        SD.remove(bankFilename(bank).c_str());
    }

    void onBankChanged() {
        if (currentBank == lastBank) {
            return;
        }
        stopIfActive();
        lastBank = currentBank;
    }

    void draw() {
        display.fillScreen(BLACK);

        for (MenuItem* menuItem : menuItems) {
            if (menuItem) {
                menuItem->draw();
            }
        }

        flushDisplay();
        lastVisual = currentVisual();
    }

public:
    bool isRecording() const {
        return state == 1;
    }

    bool isRecorderBusy() const {
        return state == 1 || state == 2 || recorderPlayWav.isPlaying();
    }

    void refresh() override {
        if (!isActive()) {
            home();
            return;
        }
        draw();
    }

    RecordPage() {
        menuItems[0] = new SimpleButton(0, 0, 0, "<", [this]() { leavePage(); }, 1, Align::Left);
        menuItems[1] = new IntEditor(18, 0, 142, "Bank:", &currentBank, 1, 0, RECORD_BANK_SIZE - 1, 1, Align::Left);
        menuItems[2] = new RecordButton(80, 34, [this]() { return currentVisual(); }, [this]() { onRecordPress(); });
        menuItems[3] = new OptionsSelector(0, 60, 118, "Source:", sourceOptions, 3, &sourceIndex, 1, Align::Spread);
        menuItems[4] = new SimpleButton(120, 60, 40, "Clear", [this]() { onClearPress(); }, 1, Align::Right);

        menuItems[0]->setFocused(true);
    }

    void init() {
        if (initialized) {
            return;
        }

        if (!SD.exists("recordings")) {
            SD.mkdir("recordings");
        }

        for (int i = 0; i < RECORD_BANK_SIZE; i++) {
            char path[32];
            recordingPath(i, path, sizeof(path));
            bankUsed[i] = SD.exists(path);
        }

        playSDMixer.gain(2, 1);
        playSDMixer.gain(3, 1);
        initialized = true;
    }

    void home() override {
        setActive(false);
        display.fillScreen(BLACK);
        display.drawBitmap(0, 0, RECORD_HOME_BITMAP, 160, 80, WHITE);
        drawArrows();
        flushDisplay();
    }

    void setup() override {
        if (recorderPlayWav.isPlaying()) {
            state = 2;
        } else if (state == 2) {
            state = 0;
            playbackStartMs = 0;
        }
        lastBank = currentBank;
        lastVisual = currentVisual();
        cursor = 0;
        for (int i = 0; i < MENU_ITEM_COUNT; i++) {
            if (menuItems[i]) {
                menuItems[i]->setFocused(i == 0);
            }
        }
        draw();
    }

    void loop() override {
        if (bounce.fell()) {
            menuItems[cursor]->onButtonPress();
            onBankChanged();
            if (isActive()) {
                draw();
            }
        }

        int encoder = readEncoder();
        if (encoder != 0) {
            MenuItem* currentItem = menuItems[cursor];
            const int next = cursor + encoder;
            if (!currentItem->onEncoderTurn(encoder) && next >= 0 && next < MENU_ITEM_COUNT) {
                currentItem->setFocused(false);
                cursor = next;
                menuItems[cursor]->setFocused(true);
            }
            onBankChanged();
            if (isActive()) {
                draw();
            }
        }
    }

    void update() override {
        if (state == 1) {
            AudioRecordQueue* queue = queueForSource(recordingSourceIndex);
            while (queue->available() >= 2) {
                continueRecording();
            }
            return;
        }

        if (state == 2 && !recorderPlayWav.isPlaying()) {
            if (playbackStartMs != 0 && (millis() - playbackStartMs) < 400) {
                return;
            }
            state = 0;
            playbackStartMs = 0;
            if (isActive()) {
                draw();
            }
        }
    }
};